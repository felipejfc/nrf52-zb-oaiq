## Kconfig
```kconfig
#
# Copyright (c) 2022 Nordic Semiconductor
#
# SPDX-License-Identifier: LicenseRef-Nordic-5-Clause
#

rsource "modules/bme688/Kconfig"
rsource "subsys/bme688_server/Kconfig"

if USB
config USB_DEVICE_PID
	default 0x53A0
endif

# How often sensor data is read
config WEATHER_CHECK_PERIOD_SECONDS
	int
	default 300

# Delay after app initialization
config FIRST_WEATHER_CHECK_DELAY_SECONDS
	int
	default 5

source "Kconfig.zephyr"

module = NRF52_ZB_OAIQ
module-str = nRF52 ZB OAIQ
source "subsys/logging/Kconfig.template.log_config"
```

## sample.yaml
```yaml
sample:
  name: Zigbee Weather Station
  description: Zigbee Weather Station application
tests:
  applications.nrf52_zb_oaiq:
    build_only: true
    platform_allow: xiao_ble
    tags: ci_build
    extra_args: CONF_FILE=prj_release.conf
    integration_platforms:
      - xiao_ble
  applications.nrf52_zb_oaiq.debug:
    build_only: true
    platform_allow: xiao_ble
    tags: ci_build debug
    extra_args: CONF_FILE=prj.conf
```
